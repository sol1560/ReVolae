## firmware/dongle/esp32s3/sdkconfig.defaults
```kconfig
CONFIG_IDF_TARGET="esp32s3"
CONFIG_TINYUSB_NET_MODE_NCM=y
CONFIG_TINYUSB_HID_COUNT=1
CONFIG_TINYUSB_NCM_OUT_NTB_BUFFS_COUNT=3
CONFIG_TINYUSB_NCM_IN_NTB_BUFFS_COUNT=3
CONFIG_TINYUSB_NCM_OUT_NTB_BUFF_MAX_SIZE=3200
CONFIG_TINYUSB_NCM_IN_NTB_BUFF_MAX_SIZE=3200
CONFIG_LWIP_LOCAL_HOSTNAME="cuaremote-dongle"
CONFIG_ESP_MAIN_TASK_STACK_SIZE=8192
```
